## rpi/conf/bblayers.conf
```bitbake
# POKY_BBLAYERS_CONF_VERSION is increased each time build/conf/bblayers.conf
# changes incompatibly
POKY_BBLAYERS_CONF_VERSION = "2"

BBPATH = "${TOPDIR}"
BBFILES ?= ""

BBLAYERS ?= " \
    /yocto/layers/poky/meta \
    /yocto/layers/poky/meta-poky \
    /yocto/layers/meta-openembedded/meta-oe \
    /yocto/layers/meta-openembedded/meta-multimedia \
    /yocto/layers/meta-openembedded/meta-networking \
    /yocto/layers/meta-openembedded/meta-perl \
    /yocto/layers/meta-openembedded/meta-python \
    /yocto/layers/meta-qt5 \
    /yocto/layers/meta-raspberrypi \
    /yocto/layers/meta-rpi \
"
```
